## doorbell_tx/sdkconfig.defaults
```kconfig
# Classic ESP32 doorbell transmitter — no LED/RMT/HyperHDR.
CONFIG_IDF_TARGET="esp32"
CONFIG_ESPTOOLPY_FLASHSIZE_4MB=y

CONFIG_FREERTOS_HZ=1000
CONFIG_COMPILER_CXX_EXCEPTIONS=n
CONFIG_COMPILER_CXX_RTTI=n

CONFIG_ESP_WIFI_SOFTAP_BEACON_MAX_LEN=752
CONFIG_LWIP_MAX_SOCKETS=8

CONFIG_HTTPD_MAX_REQ_HDR_LEN=1024
CONFIG_HTTPD_MAX_URI_LEN=512

CONFIG_LOG_DEFAULT_LEVEL_INFO=y
CONFIG_ESP_MAIN_TASK_STACK_SIZE=6144
```

## sdkconfig.defaults
```kconfig
CONFIG_IDF_TARGET="esp32"

# Flash / partitions
CONFIG_ESPTOOLPY_FLASHSIZE_4MB=y
CONFIG_PARTITION_TABLE_CUSTOM=y
CONFIG_PARTITION_TABLE_CUSTOM_FILENAME="partitions.csv"
CONFIG_PARTITION_TABLE_FILENAME="partitions.csv"

# FreeRTOS
CONFIG_FREERTOS_HZ=1000

# C++
CONFIG_COMPILER_CXX_EXCEPTIONS=n
CONFIG_COMPILER_CXX_RTTI=n

# WiFi
CONFIG_ESP_WIFI_SOFTAP_BEACON_MAX_LEN=752
CONFIG_LWIP_MAX_SOCKETS=16

# mDNS
CONFIG_MDNS_MAX_SERVICES=10

# HTTP server
CONFIG_HTTPD_MAX_REQ_HDR_LEN=1024
CONFIG_HTTPD_MAX_URI_LEN=512
CONFIG_HTTPD_WS_SUPPORT=y

# Logging
CONFIG_LOG_DEFAULT_LEVEL_INFO=y
CONFIG_LOG_COLORS=y

# Main task
CONFIG_ESP_MAIN_TASK_STACK_SIZE=8192

# LED strip / RMT
CONFIG_RMT_SUPPRESS_DEPRECATE_WARN=y

# Matter / BLE commissioning (ESP-Matter on Wi‑Fi SoCs)
CONFIG_BT_ENABLED=y
CONFIG_BT_NIMBLE_ENABLED=y
CONFIG_BT_BLUEDROID_ENABLED=n
CONFIG_BT_CONTROLLER_ENABLED=y
CONFIG_ESP_MATTER_ENABLE_MATTER_SERVER=y
CONFIG_MBEDTLS_HKDF_C=y
CONFIG_ENABLE_CHIPOBLE=y
CONFIG_USE_BLE_ONLY_FOR_COMMISSIONING=y

# LumosOS owns Wi‑Fi (STA + SoftAP). Matter must not drive esp_wifi_connect / SoftAP.
# CONFIG_ENABLE_WIFI_STATION is not set
# CONFIG_ENABLE_WIFI_AP is not set

# Share Espressif mdns with neighbors discovery (CHIP minimal mdns fights :5353)
# CONFIG_USE_MINIMAL_MDNS is not set

# RAM: ESP32-WROOM has no PSRAM; Matter + NimBLE + WiFi needs aggressive trim
CONFIG_BTDM_CTRL_BLE_MAX_CONN=1
CONFIG_BT_NIMBLE_MAX_CONNECTIONS=1
CONFIG_BT_NIMBLE_ROLE_CENTRAL=n
CONFIG_BT_NIMBLE_ROLE_OBSERVER=n
CONFIG_BT_NIMBLE_MAX_BONDS=2
CONFIG_BT_NIMBLE_MAX_CCCDS=2
CONFIG_BT_NIMBLE_MSYS_1_BLOCK_COUNT=10
CONFIG_BT_NIMBLE_MSYS_1_BLOCK_SIZE=100
CONFIG_BT_NIMBLE_MSYS_2_BLOCK_COUNT=4
CONFIG_BT_NIMBLE_MSYS_2_BLOCK_SIZE=320
CONFIG_BT_NIMBLE_ACL_BUF_COUNT=5
CONFIG_BT_NIMBLE_HCI_EVT_HI_BUF_COUNT=5
CONFIG_BT_NIMBLE_HCI_EVT_LO_BUF_COUNT=3
CONFIG_EVENT_LOGGING_CRIT_BUFFER_SIZE=256
CONFIG_EVENT_LOGGING_INFO_BUFFER_SIZE=256
CONFIG_EVENT_LOGGING_DEBUG_BUFFER_SIZE=256
CONFIG_MAX_EVENT_QUEUE_SIZE=20
CONFIG_ESP_SYSTEM_EVENT_QUEUE_SIZE=16
CONFIG_HEAP_PLACE_FUNCTION_INTO_FLASH=y
```
